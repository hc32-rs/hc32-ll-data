# HC32A472 register map
File version: 1.0
CPU: CM4 r0p1, little endian, MPU, FPU, 4 interrupt priority bits
Registers are 32-bit, read-write, reset 0x0 unless marked. A register's access mark holds for its fields unless they carry their own. Offsets are from the block's base; lines under a group give offsets from that group; [hi:lo] are bit positions; {n}, {i} and the like mark numbered series; 'fields as' and 'values as' point back to an identical list; <NAME> marks a mode.

## Memory map
0x00000000 EMB_CTL1
0x00000400 ICG size 0x14
0x40008000 AES size 0x40
0x40008400 HASH size 0x80
0x40008C00 CRC size 0x100
0x40010400 EFM size 0x1A4
0x40010600 OTS size 0x3A208
0x40010800 AOS size 0x174
0x40017C00 EMB0 size 0x1C — desc EMB
0x40017C20 EMB1 size 0x1C — desc EMB
0x40017C40 EMB2 size 0x1C — desc EMB
0x40017C60 EMB3 size 0x1C — desc EMB
0x40017C80 EMB4 size 0x1C — desc EMB
0x40017CA0 EMB5 size 0x1C — desc EMB
0x40017CC0 EMB6 size 0x1C — desc EMB
0x4001C000 SPI1 size 0x1C — desc SPI
0x4001C400 SPI2 size 0x1C — desc SPI
0x4001CC00 USART1 size 0x1C
0x4001D000 USART2 size 0x1C
0x4001D400 USART3 size 0x20
0x40020000 SPI3 size 0x1C — desc SPI
0x40020400 SPI4 size 0x1C — desc SPI
0x40020C00 USART4 size 0x1C
0x40021000 USART5 size 0x1C
0x40021400 USART6 size 0x20
0x40024000 TMR01 size 0x18 — desc TMR0
0x40024400 TMR02 size 0x18 — desc TMR0
0x40024800 TMR21 size 0x24 — desc TMR2
0x40024C00 TMR22 size 0x24 — desc TMR2
0x40025000 TMR23 size 0x24 — desc TMR2
0x40025400 TMR24 size 0x24 — desc TMR2
0x40026000 TMRA5 size 0x14E
0x40026400 TMRA6 size 0x14E
0x40028400 MDIO size 0x2C
0x40038000 TMR4 size 0xEA
0x40038400 CMP1 size 0x16 — desc CMP
0x40038500 CMP2 size 0x16 — desc CMP
0x4003A000 TMRA1 size 0x14E
0x4003A400 TMRA2 size 0x14E
0x4003A800 TMRA3 size 0x14E
0x4003AC00 TMRA4 size 0x14E
0x4003B000 CMP3 size 0x16 — desc CMP
0x4003B100 CMP4 size 0x16 — desc CMP
0x4003B400 I2C1 size 0x3C — desc I2C
0x4003B800 I2C2 size 0x3C — desc I2C
0x4003BC00 I2C3 size 0x3C — desc I2C
{0x4002CC00+0x400*n} TMR{n} size 0x1A0 (n=61..69) — desc TMR6
0x4003C300 TMR6_COMMON size 0x100
0x4003E400 TMR610 size 0x1A0 — desc TMR6
0x40040000 ADC1 size 0xC5
0x40040400 ADC2 size 0xC5
0x40040800 ADC3 size 0xB1
0x40041000 DAC1 size 0x1E — desc DAC
0x40041400 DAC2 size 0x1E — desc DAC
0x40041800 DAC3 size 0x1E — desc DAC
0x40041C00 DAC4 size 0x1E — desc DAC
0x40042000 TRNG size 0x14
0x40048000 CMU size 0xC104
0x40048000 PWC size 0xC400
0x40048400 FCM size 0x24
0x40049000 WDT size 0xC
0x40049400 SWDT size 0xC
0x40049C00 CTC size 0xE
0x4004C000 RTC size 0x5D
0x4004CCE0 RMU size 0x18
0x4004F800 VREF size 0xC
0x4004FC00 PLA size 0xD0
0x40050000 MPU size 0x90
0x40050800 SRAMC size 0x34
0x40050C00 KEYSCAN size 0xC
0x40051000 INTC size 0x2A8
0x40053000 DMA1 size 0x238 — desc DMA
0x40053400 DMA2 size 0x238 — desc DMA
0x40053800 GPIO size 0x638
0x40055000 MAU size 0x18
0x40055400 PERIC size 0x20
0x40056000 DCU1 size 0x1C — desc DCU
0x40056400 DCU2 size 0x1C — desc DCU
0x40056800 DCU3 size 0x1C — desc DCU
0x40058000 FMAC1 size 0x64 — desc FMAC
0x40058400 FMAC2 size 0x64 — desc FMAC
0x40058800 FMAC3 size 0x64 — desc FMAC
0x40058C00 FMAC4 size 0x64 — desc FMAC
0x40071000 CAN3 size 0xCA — desc CAN
0x40071400 CAN2 size 0xCA — desc CAN
0x40078000 CAN1 size 0xCA — desc CAN
0x40080000 USBFS size 0xE04
0x88000000 SMC size 0x210
0x9C000000 QSPI size 0x808
0xE0042000 DBGC size 0x2C

## Interrupts
{n} GLOBAL{n}_SWINT{n} (INTC) (n=0..15) — global interrupt {n} or software interrupt {n}
{n} GLOBAL{n}_EXINT{n-16} (INTC) (n=16..31) — global interrupt {n} or external interrupt {n-16}
33 DMA1_TC0_BTC0 (DMA1) — DMA1_TC0_BTC0 interrupt
34 DMA1_TC1_BTC1 (DMA1) — DMA1_TC1_BTC1 interrupt
35 DMA1_TC2_BTC2 (DMA1) — DMA1_TC2_BTC2 interrupt
36 DMA1_TC3_BTC3 (DMA1) — DMA1_TC3_BTC3 interrupt
37 DMA1_TC4_BTC4 (DMA1) — DMA1_TC4_BTC4 interrupt
38 DMA1_TC5_BTC5 (DMA1) — DMA1_TC5_BTC5 interrupt
39 DMA1_TC6_BTC6 (DMA1) — DMA1_TC6_BTC6 interrupt
40 DMA1_TC7_BTC7 (DMA1) — DMA1_TC7_BTC7 interrupt
41 EFM_PEERR_RDCOL (EFM) — EFM_PEERR_RDCOL interrupt
43 QSPI — QSPI interrupt
44 DCU_1 (DCU1) — DCU_1 interrupt
45 DUC_2 (DCU2) — DCU_2 interrupt
46 DCU_3 (DCU3) — DUC_3 interrupt
48 DMA2_TC0_BTC0 (DMA2) — DMA2_TC0_BTC0 interrupt
49 DMA2_TC1_BTC1 (DMA2) — DMA2_TC1_BTC1 interrupt
50 DMA2_TC2_BTC2 (DMA2) — DMA2_TC2_BTC2 interrupt
51 DMA2_TC3_BTC3 (DMA2) — DMA2_TC3_BTC3 interrupt
52 DMA2_TC4_BTC4 (DMA2) — DMA2_TC4_BTC4 interrupt
53 DMA2_TC5_BTC5 (DMA2) — DMA2_TC5_BTC5 interrupt
54 DMA2_TC6_BTC6 (DMA2) — DMA2_TC6_BTC6 interrupt
55 DMA2_TC7_BTC7 (DMA2) — DMA2_TC7_BTC7 interrupt
56 MAU — MAU interrupt
57 FMAC_1 (FMAC1) — Filter unit 1 calculate complete interrupt
58 FMAC_2 (FMAC2) — Filter unit 2 calculate complete interrupt
59 FMAC_3 (FMAC3) — Filter unit 3 calculate complete interrupt
60 FMAC_4 (FMAC4) — Filter unit 4 calculate complete interrupt
61 TMR0_1 (TMR01) — Timer0 unit 1 interrupt
62 TMR0_2 (TMR02) — Timer0 unit 2 interrupt
63 TMR2_1 (TMR21) — Timer2 unit 1 compare match or input capture interrupt
64 TMR2_1 (TMR21) — Timer2 unit 1 counter overflow interrupt
65 TMR2_2 (TMR22) — Timer2 unit 2 compare match or input capture interrupt
66 TMR2_2 (TMR22) — Timer2 unit 2 counter overflow interrupt
67 TMR2_3 (TMR23) — Timer2 unit 3 compare match or input capture interrupt
68 TMR2_3 (TMR23) — Timer2 unit 3 counter overflow interrupt
69 TMR2_4 (TMR24) — Timer2 unit 4 compare match or input capture interrupt
70 TMR2_4 (TMR24) — Timer2 unit 4 counter overflow interrupt
71 RTC — RTC interrupt
72 CMU_XTAL_STOP (CMU) — Xtal stop interrupt
73 PWC_WKTM (PWC) — WKTM compare match interrupt
74 SWDT — SWDT interrupt
75 TMR6_1_GCMP (TMR61) — TMR6_1_GCMP interrupt
76 TMR6_1_OVF_UDF (TMR61) — TMR6_1_OVF_UDF interrupt
78 TMR6_1_SCMP (TMR61) — TMR6_1_SCMP interrupt
79 TMRA_1_OVF_UDF (TMRA1) — TMRA_1_OVF_UDF interrupt
80 TMRA_1_CMP (TMRA1, TMRA2) — TMRA_1_CMP interrupt
81 TMR6_2_GCMP (TMR62) — TMR6_2_GCMP interrupt
82 TMR6_2_OVF_UDF (TMR62) — TMR6_2_OVF_UDF interrupt
84 TMR6_2_SCMP (TMR62) — TMR6_2_SCMP interrupt
85 TMRA_2_OVF_UDF (TMRA2) — TMRA_2_OVF_UDF interrupt
86 TMRA_2_CMP (TMRA3) — TMRA_2_CMP interrupt
87 TMR6_3_GCMP (TMR63) — TMR6_3_GCMP interrupt
88 TMR6_3_OVF_UDF (TMR63) — TMR6_3_OVF_UDF interrupt
90 TMR6_3_SCMP (TMR63) — TMR6_3_SCMP interrupt
91 TMRA_3_OVF_UDF (TMRA3) — TMRA_3_OVF_UDF interrupt
92 TMRA_3_CMP (TMRA4) — TMRA_3_CMP interrupt
93 TMR6_4_GCMP (TMR64) — TMR6_4_GCMP interrupt
94 TMR6_4_OVF_UDF (TMR64) — TMR6_4_OVF_UDF interrupt
96 TMR6_4_SCMP (TMR64) — TMR6_4_SCMP interrupt
97 TMRA_4_OVF_UDF (TMRA4) — TMRA_4_OVF_UDF interrupt
99 TMR6_5_GCMP (TMR65) — TMR6_5_GCMP interrupt
100 TMR6_5_OVF_UDF (TMR65) — TMR6_5_OVF_UDF interrupt
102 TMR6_5_SCMP (TMR65) — TMR6_5_SCMP interrupt
104 TMR6_6_GCMP (TMR66) — TMR6_6_GCMP interrupt
105 TMR6_6_OVF_UDF (TMR66) — TMR6_6_OVF_UDF interrupt
107 TMR6_6_SCMP (TMR66) — TMR6_6_SCMP interrupt
108 TMR6_7_GCMP (TMR67) — TMR6_7_GCMP interrupt
109 TMR6_7_OVF_UDF (TMR67) — TMR6_7_OVF_UDF interrupt
111 TMR6_7_SCMP (TMR67) — TMR6_7_SCMP interrupt
112 TMR6_8_GCMP (TMR68) — TMR6_8_GCMP interrupt
113 TMR6_8_OVF_UDF (TMR68) — TMR6_8_OVF_UDF interrupt
115 TMR6_8_SCMP (TMR68) — TMR6_8_SCMP interrupt
116 TMR6_9_GCMP (TMR69) — TMR6_9_GCMP interrupt
117 TMR6_9_OVF_UDF (TMR69) — TMR6_9_OVF_UDF interrupt
119 TMR6_9_SCMP (TMR69) — TMR6_9_SCMP interrupt
120 TMR6_10_GCMP (TMR610) — TMR6_10_GCMP interrupt
121 TMR6_10_OVF_UDF (TMR610) — TMR6_10_OVF_UDF interrupt
123 TMR6_10_SCMP (TMR610) — TMR6_10_SCMP interrupt
124 TMR4_1_GCMP (TMR4) — TMR4_1_GCMP interrupt
125 TMR4_1_OVF_UDF (TMR4) — TMR4_1_OVF_UDF interrupt
126 TMR4_1_RELOAD (TMR4) — TMR4_1_RELOAD interrupt
128 CMP1 — CMP1 interrupt
129 CMP2 — CMP2 interrupt
130 CMP3 — CMP3 interrupt
131 CMP4 — CMP4 interrupt
132 CAN_1 (CAN1) — CAN_1 HOST interrupt
133 CAN_2 (CAN2) — CAN_2 HOST interrupt
134 CAN_3 (CAN3) — CAN_3 HOST interrupt
135 USART1 — USART1 interrupt
136 USART2 — USART2 interrupt
137 SPI_1 (SPI1) — SPI unit 1 interrupt
138 SPI_2 (SPI2) — SPI unit 2 interrupt
139 TMRA_5_OVF_UDF (TMRA5) — TMRA_5_OVF_UDF interrupt
140 TMRA_5_CMP (TMRA5) — TMRA_5_CMP interrupt
141 TMRA_6_OVF_UDF (TMRA6) — TMRA_6_OVF_UDF interrupt
142 TMRA_6_CMP (TMRA6) — TMRA_6_CMP interrupt
143 USBFS — USBFS global interrupt
144 EVENT_PORT1 (GPIO) — EVENT_PORT1 interrupt
145 EVENT_PORT2 (GPIO) — EVENT_PORT2 interrupt
146 EVENT_PORT3 (GPIO) — EVENT_PORT3 interrupt
147 EVENT_PORT4 (GPIO) — EVENT_PORT4 interrupt
148 USART3 — USART3 interrupt
149 USART4 — USART4 interrupt
150 SPI_3 (SPI3) — SPI unit 3 interrupt
151 SPI_4 (SPI4) — SPI unit 4 interrupt
152 EMB_GR0 (EMB0) — EMB_GR0 interrupt
153 EMB_GR1 (EMB1) — EMB_GR1 interrupt
154 EMB_GR2 (EMB2) — EMB_GR2 interrupt
155 EMB_GR3 (EMB3) — EMB_GR3 interrupt
156 EMB_GR4 (EMB4) — EMB_GR4 interrupt
157 EMB_GR5 (EMB5) — EMB_GR5 interrupt
158 EMB_GR6 (EMB6) — EMB_GR6 interrupt
159 CPM (HASH) — HASH interrupt
160 USART5 — USART5 interrupt
161 USART6 — USART6 interrupt
162 MDIO — MDIO interrupt
163 PLA — PLA interrupt
164 I2C_1 (I2C1) — I2C unit 1 interrupt
165 I2C_2 (I2C2) — I2C unit 2 interrupt
166 I2C_3 (I2C3) — I2C unit 3 interrupt
167 USART1_WUPI (USART1) — USART1_WUPI interrupt
168 PWC_PVD1 (PWC) — Programable voltage detect unit 1 interrupt
169 PWC_PVD2 (PWC) — Programable voltage detect unit 2 interrupt
170 OTS — OTS interrupt
171 CMU_FCM (CMU) — FCM frequency measure complete interrupt
172 WDT — WDT interrupt
173 CTC — CTC interrupt
174 ADC_1 (ADC1) — ADC unit 1 interrupt
175 ADC_2 (ADC2) — ADC unit 2 interrupt
176 ADC_3 (ADC3) — ADC unit 3 interrupt
177 CPM (TRNG) — TRNG interrupt
