# HC32M458 register map
File version: 1.0
CPU: CM4 r0p1, little endian, MPU, FPU, 4 interrupt priority bits
Registers are 16-bit, read-write, reset 0x0 unless marked. A register's access mark holds for its fields unless they carry their own. Offsets are from the block's base; lines under a group give offsets from that group; [hi:lo] are bit positions; {n}, {i} and the like mark numbered series; 'fields as' and 'values as' point back to an identical list; <NAME> marks a mode.

## Memory map
0x00080000 ICG size 0x14
0x01001C50 EFM2 size 0x10
0x40010400 EFM size 0x289
0x40010800 AOS size 0x30
0x40017C00 EMB0 size 0x20 — desc EMB
0x40017C20 EMB1 size 0x20 — desc EMB
0x40017C40 EMB2 size 0x20 — desc EMB
0x40017C60 EMB3 size 0x20 — desc EMB
0x4001C000 SPI1 size 0x1C — desc SPI
0x4001C400 SPI2 size 0x1C — desc SPI
0x4001CC00 USART1 size 0x20 — desc USART
0x4001D000 USART2 size 0x20 — desc USART
0x40020C00 USART3 size 0x20 — desc USART
0x40021000 USART4 size 0x20 — desc USART
0x40024000 TMR01 size 0x18 — desc TMR0
0x40024400 TMR02 size 0x18 — desc TMR0
0x40026000 TMRA5 size 0x1AA — desc TMRA
0x40038000 TMR41 size 0x116
0x40038400 TMR42 size 0x116
0x40038800 CMP1 size 0x20 — desc CMP
0x40038900 CMP2 size 0x20 — desc CMP
0x4003A000 TMRA1 size 0x1AA — desc TMRA
0x4003A400 TMRA2 size 0x1AA — desc TMRA
0x4003A800 TMRA3 size 0x1AA — desc TMRA
0x4003AC00 TMRA4 size 0x1AA — desc TMRA
0x4003B400 I2C size 0x3C
0x40040000 ADC1 size 0x140
0x40040400 ADC2 size 0x124
0x40042000 TRNG size 0x14
0x40048400 FCM size 0x24
0x40049000 WDT size 0xC
0x40049400 SWDT size 0xC
0x40050000 DFM size 0x40
0x40050400 CRC size 0x100
0x40050800 SRAMC size 0x34
0x40051000 INTC size 0x6C
0x40053000 DMA size 0xB8
0x40053800 GPIO size 0x7CC
0x40054000 CMU size 0x49
0x40054400 PWC size 0x54
0x40054500 RMU size 0x20
0x40054800 MAU size 0x2C
0x40055400 PERIC size 0x20
0xE0042000 DBGC size 0x40

## Interrupts
{n} EXTINT{n}_SWINT{n} (INTC) (n=0..7) — external interrupt or software interrupt {n}
8 TMR0_1_SWINT8 (TMR01) — timer0 unit1 interrupt or software interrupt 8
9 TMR0_2_SWINT9 (TMR02) — timer0 unit2 interrupt or software interrupt 9
10 XTAL_STOP_SWINT10 (CMU) — xtal stop interrupt or software interrupt 10
11 SWDT_SWINT11 (SWDT) — SWDT underflow or refresh error interrupt or software interrupt 11
12 LVD1_SWINT12 (PWC) — Low voltage detect unit 1 interrupt or software interrupt 12
13 LVD2_SWINT13 (PWC) — Low voltage detect unit 2 interrupt or software interrupt 13
14 DMA_TC0_BC0_SWINT14 (DMA) — DMA transmission complete 0 or block transmission complete 0 interrupt or software interrupt 14
15 DMA_TC1_BTC1_SWINT15 (DMA) — DMA transmission complete 1 or block transmission complete 1 interrupt or software interrupt 15
16 DMA_ERR_SWINT16 (DMA) — DAM transmission error or software interrupt 16
17 EFM_SWINT17 (EFM) — EFM program PE error read column error operation end interrupt or software interrupt 17
18 DFM_SWINT18 (DFM) — DFM PE done PE error or software interrupt 18
19 FPU_SWINT19 (INTC) — FPU error interrupt or software interrupt 19
20 MAU_SWINT20 (MAU) — MAU calculate complete interrupt or software interrupt 20
21 TMR41_OVF_SWINT21 (TMR41) — TMR41 overflow interrupt or software interrupt 21
22 TMR41_UDF_SWINT22 (TMR41) — TMR41 underflow interrupt or software interrupt 22
23 TMR41_RELOAD_SWINT23 (TMR41) — TMR41 reload matched interrupt or software interrupt 23
24 TMR41_GCM_SWINT24 (TMR41) — TMR41 general compare matched interrupt or software interrupt 24
25 TMR41_SCM_SWINT25 (TMR41) — TMR41 special compare matched interrupt or software interrupt 25
26 TMRA1_OVF_SWINT26 (TMRA1) — TMRA1 overflow interrupt or software interrupt 26
27 TMRA1_UDF_SWINT27 (TMRA1) — TMRA1 underflow interrupt or software interrupt 27
28 TMRA1_CMP_SWINT28 (TMRA1) — TMRA1 compare interrupt or software interrupt 28
29 TMRA2_OVF_SWINT29 (TMRA2) — TMRA2 overflow interrupt or software interrupt 29
30 TMRA2_UDF_SWINT30 (TMRA2) — TMRA2 underflow interrupt or software interrupt 30
31 TMRA2_CMP_SWINT31 (TMRA2) — TMRA2 compare interrupt or software interrupt 31
32 TMR42_OVF (TMR42) — TMR42 overflow interrupt
33 TMR42_UDF (TMR42) — TMR42 underflow interrupt
34 TMR42_RELOAD (TMR42) — TMR42 reload matched interrupt
35 TMR42_GCM (TMR42) — TMR42 general compare matched interrupt
36 TMR42_SCM (TMR42) — TMR42 special compare matched interrupt
37 TMRA3_OVF (TMRA3) — TMRA3 overflow interrupt
38 TMRA3_UDF (TMRA3) — TMRA3 underflow interrupt
39 TMRA3_CMP (TMRA3) — TMRA3 compare interrupt
40 TMRA4_OVF (TMRA4) — TMRA4 overflow interrupt
41 TMRA4_UDF (TMRA4) — TMRA4 underflow interrupt
42 TMRA4_CMP (TMRA4) — TMRA4 compare interrupt
43 CMP1 — CMP1 interrupt
44 CMP2 — CMP2 interrupt
45 EMB (EMB0) — EMB interrupt
46 I2C_RF_SE (I2C) — I2C receive full or send empty interrupt
47 I2C_TC_Err (I2C) — I2C transmission complete or error interrupt
48 TMRA5_OVF (TMRA5) — TMRA5 overflow interrupt
49 TMRA5_UDF (TMRA5) — TMRA5 underflow interrupt
50 TMRA5_CMP (TMRA5) — TMRA5 compare interrupt
53 USART1_TCI (USART1) — USART1_TCI interrupt
56 USART2_TCI (USART2) — USART2_TCI interrupt
59 USART3_TCI (USART3) — USART3_TCI interrupt
62 USART4_TCI (USART4) — USART4_TCI interrupt
63 SPI1_RF_SE (SPI1) — SPI1 receive full or send empty interrupt
64 SPI1_Idle_Err (SPI1) — SPI1 idle or error interrupt
65 SPI2_RF_SE (SPI2) — SPI2 receive full or send empty interrupt
66 SPI2_Idle_Err (SPI2) — SPI2 idle or error interrupt
67 FCM — FCM interrupt
68 WDT — WDT interrupt
70 ADC1_EOCA (ADC1) — ADC1 end of conversion interrupt
71 ADC1_EOCB (ADC1) — ADC1 end of conversion sequence B interrupt
72 ADC1_EOCC (ADC1) — ADC1 end of conversion sequence C interrupt
73 ADC1_AWD01 (ADC1) — ADC1 analog watchdog 0 or 1 interrupt
74 ADC2_EOCA (ADC2) — ADC2 end of conversion interrupt
75 ADC2_EOCB (ADC2) — ADC2 end of conversion sequence B interrupt
76 ADC2_EOCC (ADC2) — ADC2 end of conversion sequence C interrupt
77 ADC2_AWD01 (ADC2) — ADC2 analog watchdog 0 or 1 interrupt
78 TRNG — TRNG interrupt
